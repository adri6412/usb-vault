## board/vaultusb/Config.in
```kconfig
menu "VaultUSB"

config BR2_PACKAGE_VAULTUSB
    bool "vaultusb overlay"
    help
      Installa l'overlay di VaultUSB nel rootfs.

source "$BR2_EXTERNAL_VAULTUSB_PATH/package/vaultusb_cpp/Config.in"

endmenu
```

## board/vaultusb/configs/raspberrypi0_vaultusb_defconfig
```kconfig
BR2_arm=y
BR2_cortex_a7=y
BR2_ARM_FPU_VFPV3D16=y
BR2_ARM_EABIHF=y

# Base defconfig for Raspberry Pi Zero W - using standard Buildroot packages
# Use Raspberry Pi firmware instead of custom bootloader
BR2_TARGET_RPI_FIRMWARE=y
BR2_TARGET_RPI_FIRMWARE_BOOTCODE_BIN=y
BR2_TARGET_RPI_FIRMWARE_VARIANT_PI_ZERO_W=y

# Linux kernel for Raspberry Pi - use correct defconfig
BR2_LINUX_KERNEL=y
BR2_LINUX_KERNEL_DEFCONFIG="bcm2835_defconfig"
BR2_LINUX_KERNEL_DTS_SUPPORT=y
BR2_LINUX_KERNEL_INTREE_DTS_NAME="bcm2708-rpi-zero-w"
BR2_LINUX_KERNEL_NEEDS_HOST_OPENSSL=y
BR2_LINUX_KERNEL_NEEDS_HOST_LIBELF=y

# Filesystem configuration
BR2_TARGET_ROOTFS_EXT2=y
BR2_TARGET_ROOTFS_EXT2_4=y
BR2_TARGET_ROOTFS_EXT2_SIZE="120M"
BR2_TARGET_ROOTFS_EXT2_BLOCKS=0
BR2_TARGET_ROOTFS_EXT2_INODES=0
BR2_TARGET_ROOTFS_EXT2_RESBLKS=0
BR2_TARGET_ROOTFS_EXT2_LABEL="rootfs"

# Use systemd as init system
BR2_INIT_SYSTEMD=y
BR2_INIT_BUSYBOX=n
BR2_PACKAGE_SYSTEMD=y
BR2_PACKAGE_SYSTEMD_UTILS=y
BR2_PACKAGE_SYSTEMD_NETWORKD=y
BR2_PACKAGE_SYSTEMD_RESOLVED=y
BR2_PACKAGE_SYSTEMD_TIMESYNCD=y

# Disable BusyBox completely
BR2_PACKAGE_BUSYBOX=n
BR2_SYSTEM_BIN_SH_BUSYBOX=n
BR2_SYSTEM_BIN_SH_BASH=y

# Networking
BR2_PACKAGE_HOSTAPD=y
BR2_PACKAGE_DNSMASQ=y
BR2_PACKAGE_IFUPDOWN_SCRIPTS=y
BR2_PACKAGE_NETIFRC=y

# C++ runtime and libraries
BR2_TOOLCHAIN_BUILDROOT_CXX=y
BR2_PACKAGE_LIBSTDCPP=y

# SQLite3 for database
BR2_PACKAGE_SQLITE=y

# OpenSSL for crypto operations
BR2_PACKAGE_OPENSSL=y
BR2_PACKAGE_OPENSSL_BIN=y

# Argon2 for password hashing
BR2_PACKAGE_LIBARGON2=y

# Additional utilities
BR2_PACKAGE_UTIL_LINUX=y
BR2_PACKAGE_UTIL_LINUX_LIBUUID=y
BR2_PACKAGE_UTIL_LINUX_LIBBLKID=y

# Filesystem resize utilities
BR2_PACKAGE_E2FSPROGS=y
BR2_PACKAGE_E2FSPROGS_RESIZE2FS=y
BR2_PACKAGE_PARTED=y
BR2_PACKAGE_FDISK=y

# Rootfs overlay
BR2_ROOTFS_OVERLAY="${OVERLAY_DIR}"

# Enable VaultUSB C++ package
BR2_PACKAGE_VAULTUSB_CPP=y

# Enable systemd service at boot
BR2_SYSTEM_DHCP="eth0"

# Post-build script to create SD card image
BR2_ROOTFS_POST_BUILD_SCRIPT="$(BR2_EXTERNAL_VAULTUSB_PATH)/board/vaultusb/patches/post-build.sh"

# Host tools needed for image creation
BR2_PACKAGE_HOST_GENIMAGE=y
BR2_PACKAGE_HOST_DOSFSTOOLS=y
BR2_PACKAGE_HOST_MTOOLS=y
BR2_PACKAGE_HOST_PARTED=y

# Additional packages for auto-resize
BR2_PACKAGE_PARTED=y
BR2_PACKAGE_FDISK=y
```

## board/vaultusb/package/vaultusb-cpp/Config.in
```kconfig
config BR2_PACKAGE_VAULTUSB_CPP
	bool "vaultusb-cpp"
	depends on BR2_TOOLCHAIN_HAS_THREADS
	depends on BR2_INSTALL_LIBSTDCPP
	select BR2_PACKAGE_SQLITE
	select BR2_PACKAGE_OPENSSL
	select BR2_PACKAGE_LIBARGON2
	help
	  VaultUSB C++ server for encrypted file storage and WiFi management
	  on Raspberry Pi Zero.

	  https://github.com/your-repo/vaultusb
```

## board/vaultusb/package/vaultusb_cpp/Config.in
```kconfig
config BR2_PACKAGE_VAULTUSB_CPP
    bool "vaultusb C++ server"
    help
      Minimal C++ HTTP server for VaultUSB providing basic endpoints.
```
